## drivers/input/fingerprint/fpc_1552/Kconfig
```kconfig
config FINGERPRINT_FPC_1552
	tristate "FPC 1552 fingerprint sensor"
	default n
	depends on INPUT_FINGERPRINT
	help
	  Say Y here to enable the FPC 1552 platform-resource driver.
	  If unsure, say N.
	  To compile this driver as a module, choose M here.
```

## drivers/input/touchscreen/nt36532/Kconfig
```kconfig
# SPDX-License-Identifier: GPL-2.0-only

config TOUCHSCREEN_NT36532_SPI
	tristate "Novatek NT36532 host-download SPI touchscreen"
	depends on SPI_MASTER && OF && DRM
	depends on QCOM_SMEM
	depends on QCOM_PANEL_EVENT_NOTIFIER
	depends on QTI_BATTERY_CHARGER
	depends on TOUCHSCREEN_XIAOMI_TOUCHFEATURE_LCD
	select DRM_PANEL
	help
	  Say Y or M here if you have a Novatek NT36532 no-flash
	  touchscreen connected over SPI. The controller firmware is
	  downloaded by the driver during probe and resume.

	  If built as a module, it will be called nt36532_touch.
```

## drivers/input/touchscreen/xiaomi/Kconfig
```kconfig
config TOUCHSCREEN_XIAOMI_TOUCHFEATURE
	tristate "Xiaomi Touch Feature"
	depends on DRM
	depends on INPUT_TOUCHSCREEN
	depends on OF
	help
	  Say Y here if you want to enable xiaomi touch feature.

	  If unsure, say N.

	  To compile this driver as a module, choose M here.

config TOUCHSCREEN_XIAOMI_TOUCHFEATURE_LCD
	tristate "Xiaomi LCD Touch Feature"
	depends on INPUT_TOUCHSCREEN
	depends on TOUCHSCREEN_XIAOMI_TOUCHFEATURE = n
	help
	  Say Y here if you want to enable the LCD/TDDI-specific Xiaomi
	  touch feature interface. It forwards wake-gesture state directly
	  to the registered LCD touch controller.

	  If unsure, say N.

	  To compile this driver as a module, choose M here.
```
